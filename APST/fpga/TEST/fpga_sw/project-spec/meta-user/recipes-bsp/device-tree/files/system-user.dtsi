/include/ "system-conf.dtsi"
/ {
	chosen {
		bootargs = "console=ttyPS0,115200 earlyprintk uio_pdrv_genirq.of_id=generic-uio root=/dev/mmcblk0p2 rw rootwait";
	};
};

&axi_gpio_0 {
	compatible = "generic-uio";
};
