/include/ "system-conf.dtsi"
/ {
};

&spi0 {
  is-decoded-cs = <0>;
  num-cs = <1>;
  status = "okay";

  spidev@0x40000000 {
    compatible = "spidev";
    spi-max-frequency = <10000000>;
    reg = <0>;
  };
};
