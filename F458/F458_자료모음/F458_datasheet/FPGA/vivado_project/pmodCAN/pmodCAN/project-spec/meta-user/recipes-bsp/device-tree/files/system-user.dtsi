/include/ "system-conf.dtsi"
/ {
};

&spi0 {
  #address-cells = <1>;
  #size-cells = <0>;
  is-decoded-cs = <0>;
  num-cs = <1>;
  status = "okay";

  spidev@0x00 {
    compatible = "spidev";
    spi-max-frequency = <1000000>;
    reg = <0>;
  };
};
